## board/freescale/mx6qtedea/Kconfig
```kconfig
if TARGET_MX6QTEDEA

config SYS_BOARD
	default "mx6qtedea"

config SYS_VENDOR
	default "freescale"

config SYS_CONFIG_NAME
	default "mx6qtedea"

endif
```
